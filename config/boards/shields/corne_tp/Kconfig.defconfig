## config/boards/shields/corne_tp/Kconfig.defconfig
```kconfig
if SHIELD_CORNE_TP_RIGHT

config ZMK_KEYBOARD_NAME
	default "Corne TP"

config ZMK_SPLIT_BLE_ROLE_CENTRAL
	default y

endif

if SHIELD_CORNE_TP_LEFT || SHIELD_CORNE_TP_RIGHT

config ZMK_SPLIT
	default y

endif
```

## config/boards/shields/corne_tp_og/Kconfig.defconfig
```kconfig
if SHIELD_CORNE_TP_OG_RIGHT

config ZMK_KEYBOARD_NAME
	default "Corne TP OG"

config ZMK_SPLIT_BLE_ROLE_CENTRAL
	default y

endif

if SHIELD_CORNE_TP_OG_LEFT || SHIELD_CORNE_TP_OG_RIGHT

config ZMK_SPLIT
	default y

endif
```

## config/boards/shields/corne_tp_og/Kconfig.shield
```kconfig
config SHIELD_CORNE_TP_OG_LEFT
    def_bool $(shields_list_contains,corne_tp_og_left)

config SHIELD_CORNE_TP_OG_RIGHT
    def_bool $(shields_list_contains,corne_tp_og_right)
```

## config/boards/shields/cross_corne/Kconfig.defconfig
```kconfig
if SHIELD_CROSS_CORNE_RIGHT

config ZMK_KEYBOARD_NAME
	default "Cross Corne"

config ZMK_SPLIT_BLE_ROLE_CENTRAL
	default y

endif

if SHIELD_CROSS_CORNE_LEFT || SHIELD_CROSS_CORNE_RIGHT

config ZMK_SPLIT
	default y

endif
```

## config/boards/shields/cross_corne/Kconfig.shield
```kconfig
config SHIELD_CROSS_CORNE_LEFT
    def_bool $(shields_list_contains,cross_corne_left)

config SHIELD_CROSS_CORNE_RIGHT
    def_bool $(shields_list_contains,cross_corne_right)
```

## config/boards/shields/cross_corne_diag/Kconfig.defconfig
```kconfig
if SHIELD_CROSS_CORNE_DIAG_RIGHT

config ZMK_KEYBOARD_NAME
    default "Diag"

endif

if SHIELD_CROSS_CORNE_DIAG_LEFT

config ZMK_KEYBOARD_NAME
    default "DiagLeft"

endif
```

## config/boards/shields/cross_corne_diag/Kconfig.shield
```kconfig
config SHIELD_CROSS_CORNE_DIAG_RIGHT
    def_bool $(shields_list_contains,cross_corne_diag_right)

config SHIELD_CROSS_CORNE_DIAG_LEFT
    def_bool $(shields_list_contains,cross_corne_diag_left)
```

## config/boards/shields/cross_corne_tp/Kconfig.defconfig
```kconfig
if SHIELD_CROSS_CORNE_TP_RIGHT

config ZMK_KEYBOARD_NAME
	default "Cross Corne TP"

config ZMK_SPLIT_BLE_ROLE_CENTRAL
	default y

endif

if SHIELD_CROSS_CORNE_TP_LEFT || SHIELD_CROSS_CORNE_TP_RIGHT

config ZMK_SPLIT
	default y

endif
```

## config/boards/shields/cross_corne_tp/Kconfig.shield
```kconfig
config SHIELD_CROSS_CORNE_TP_LEFT
    def_bool $(shields_list_contains,cross_corne_tp_left)

config SHIELD_CROSS_CORNE_TP_RIGHT
    def_bool $(shields_list_contains,cross_corne_tp_right)
```

## config/boards/shields/crosses_tp/Kconfig.defconfig
```kconfig
if SHIELD_CROSSES_TP_RIGHT

config ZMK_KEYBOARD_NAME
	default "Crosses TP"

config ZMK_SPLIT_BLE_ROLE_CENTRAL
	default y

endif

if SHIELD_CROSSES_TP_LEFT || SHIELD_CROSSES_TP_RIGHT

config ZMK_SPLIT
	default y

endif
```

## config/boards/shields/crosses_tp/Kconfig.shield
```kconfig
config SHIELD_CROSSES_TP_LEFT
    def_bool $(shields_list_contains,crosses_tp_left)

config SHIELD_CROSSES_TP_RIGHT
    def_bool $(shields_list_contains,crosses_tp_right)
```

## config/west.yml
```yaml
manifest:
  remotes:
    - name: petejohanson
      url-base: https://github.com/petejohanson
    - name: george-norton
      url-base: https://github.com/george-norton
  projects:
    - name: zmk
      remote: petejohanson
      revision: feat/pointers-move-scroll-ptp
      import: app/west.yml
    - name: maxtouch-zephyr-module
      remote: george-norton
      revision: main
  self:
    path: config
```
