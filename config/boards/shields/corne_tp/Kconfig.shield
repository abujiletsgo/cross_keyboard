## config/boards/shields/corne_tp/Kconfig.shield
```kconfig
config SHIELD_CORNE_TP_LEFT
    def_bool $(shields_list_contains,corne_tp_left)

config SHIELD_CORNE_TP_RIGHT
    def_bool $(shields_list_contains,corne_tp_right)
```
