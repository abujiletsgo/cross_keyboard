/*
 * Copyright (c) 2020 ZMK Contributors
 *
 * SPDX-License-Identifier: MIT
 */

#include "cross_corne.dtsi"

/*
 * col-gpios: physical columns driven HIGH, listed outer→inner
 * (local col 0 = outermost/pinky = TAB, local col 5 = innermost/index = T)
 */
&kscan0 {
    col-gpios
        = <&gpio0 29 GPIO_ACTIVE_HIGH>
        , <&gpio1 4  GPIO_ACTIVE_HIGH>
        , <&gpio0 11 GPIO_ACTIVE_HIGH>
        , <&gpio1 0  GPIO_ACTIVE_HIGH>
        , <&gpio0 24 GPIO_ACTIVE_HIGH>
        , <&gpio0 22 GPIO_ACTIVE_HIGH>
        ;
};
